## Documentation/devicetree/bindings/misc/nintendo,nunchuk.yaml
```yaml
# SPDX-License-Identifier: GPL-2.0 OR BSD-2-Clause
%YAML 1.2
---
$id: http://devicetree.org/schemas/misc/nintendo,nunchuk.yaml#
$schema: http://devicetree.org/meta-schemas/core.yaml#

title: Nintendo Nunchuk

maintainers:
  - Antoine Merino <antoine.merino.dev@gmail.com>

properties:
  compatible:
    const: nintendo,nunchuk

  reg:
    maxItems: 1
    description: I2C address of the device

  nintendo,alternate-init:
    type: boolean
    description: Use alternate initialization sequence

additionalProperties: false

required:
  - compatible
  - reg

examples:
  - |
    /* This is a valid example */
    i2c {
        #address-cells = <1>;
        #size-cells = <0>;

        joystick@52 {
            compatible = "nintendo,nunchuk";
            reg = <0x52>;
        };
    };
  - |
    /* This is a valid example */
    i2c {
        #address-cells = <1>;
        #size-cells = <0>;

        joystick@52 {
            compatible = "nintendo,nunchuk";
            reg = <0x52>;
            nintendo,alternate-init;
        };
    };
```
